## CMakeLists.txt
```
#-------------------------------------------------------------------------------
# Zephyr Example Application
#
# Copyright (c) 2021 Nordic Semiconductor ASA
# SPDX-License-Identifier: Apache-2.0

cmake_minimum_required(VERSION 3.13.1)
find_package(Zephyr REQUIRED HINTS $ENV{ZEPHYR_BASE})

project(app LANGUAGES C)

zephyr_include_directories(src)

target_sources(app PRIVATE
    src/main.c
    src/miniproj_fsm.c
)
```

## prj.conf
```kconfig
# Copyright (c) 2021 Nordic Semiconductor ASA
# SPDX-License-Identifier: Apache-2.0
#
# This file contains selected Kconfig options for the application.

CONFIG_GPIO=y
CONFIG_PWM=y
CONFIG_SMF=y
CONFIG_BT=y
CONFIG_BT_CENTRAL=y
CONFIG_BT_GATT_CLIENT=y
CONFIG_BT_HCI_ERR_TO_STR=y
```

## src/main.c
```c
/*
 * main.c
 */

#include <inttypes.h>

#include <errno.h>
#include <inttypes.h>
#include <stddef.h>
#include <stdlib.h>
#include <zephyr/bluetooth/bluetooth.h>
#include <zephyr/bluetooth/conn.h>
#include <zephyr/bluetooth/gatt.h>
#include <zephyr/bluetooth/hci.h>
#include <zephyr/bluetooth/uuid.h>
#include <zephyr/kernel.h>
#include <zephyr/sys/byteorder.h>
#include <zephyr/sys/printk.h>
#include <zephyr/types.h>

#include "BTN.h"
#include "LED.h"


//Defines and Macros
#define SLEEP_MS 1
#define TARGET_PHONE_NAME "Jad’s iPhone"

//set UUID's make sure they are unique
static struct bt_uuid_128 BLE_CUSTOM_SERVICE_UUID =
    BT_UUID_INIT_128(BT_UUID_128_ENCODE(0x11111111, 0x2222, 0x3333, 0x4444, 0x000000000001)); //UUID is 128 bits encoded with 5 vars
static struct bt_uuid_128 BLE_CUSTOM_CHARACTERISTIC_UUID =
    BT_UUID_INIT_128(BT_UUID_128_ENCODE(0x11111111, 0x2222, 0x3333, 0x4444, 0x000000000002));


//variables and functions
static struct bt_conn* my_connection = NULL;
static struct bt_uuid_16 discover_uuid = BT_UUID_INIT_16(0);
static struct bt_gatt_discover_params discover_params;
static struct bt_gatt_subscribe_params subscribe_params;

static uint8_t notify_func(struct bt_conn* conn, struct bt_gatt_subscribe_params* params,
                           const void* data, uint16_t length) {
  if (!data) {
    printk("[UNSUBSCRIBED]\n");
    params->value_handle = 0U;
    return BT_GATT_ITER_STOP;
  }

  printk("[NOTIFICATION] data %p length %u\n", data, length);
  for (int i = 0; i < MIN(length, 16); i++) {
    printk(" 0x%02X", ((uint8_t*)data)[i]);
  }
  printk("\n");

  return BT_GATT_ITER_CONTINUE;
}


static uint8_t discover_func(struct bt_conn* conn, const struct bt_gatt_attr* attr,
                             struct bt_gatt_discover_params* params) {
  int err;

  if (!attr) {
    printk("Discover complete\n");
    (void)memset(params, 0, sizeof(*params));
    return BT_GATT_ITER_STOP;
  }

  printk("[ATTRIBUTE] handle %u\n", attr->handle);

  if (!bt_uuid_cmp(discover_params.uuid, &BLE_CUSTOM_SERVICE_UUID.uuid)) {
    discover_params.uuid = &BLE_CUSTOM_CHARACTERISTIC_UUID.uuid;
    discover_params.start_handle = attr->handle + 1;
    discover_params.type = BT_GATT_DISCOVER_CHARACTERISTIC;

    err = bt_gatt_discover(conn, &discover_params);
    if (err) {
      printk("Discover failed (err %d)\n", err);
    }
  } else if (!bt_uuid_cmp(discover_params.uuid, &BLE_CUSTOM_CHARACTERISTIC_UUID.uuid)) {
    memcpy(&discover_uuid, BT_UUID_GATT_CCC, sizeof(discover_uuid));
    discover_params.uuid = &discover_uuid.uuid;
    discover_params.start_handle = attr->handle + 2;
    discover_params.type = BT_GATT_DISCOVER_DESCRIPTOR;
    subscribe_params.value_handle = bt_gatt_attr_value_handle(attr);

    err = bt_gatt_discover(conn, &discover_params);
    if (err) {
      printk("Discover failed (err %d)\n", err);
    }
  } else {
    subscribe_params.notify = notify_func;
    subscribe_params.value = BT_GATT_CCC_NOTIFY;
    subscribe_params.ccc_handle = attr->handle;

    err = bt_gatt_subscribe(conn, &subscribe_params);
    if (err && err != -EALREADY) {
      printk("Subscribe failed (err %d)\n", err);
    } else {
      printk("[SUBSCRIBED]\n");
    }

    return BT_GATT_ITER_STOP;
  }

  return BT_GATT_ITER_STOP;
}

static void ble_on_device_connected(struct bt_conn* conn, uint8_t err) {
  //check if err is nor equal to 0, any other value means fail
  if(0 != err){
    printk("Connection failed (err %u)\n", err);
    bt_conn_unref(my_connection);
    my_connection = NULL;
    return;
  }
  //check if connection are same
  if(my_connection != conn){
    return;
  }
  //get address of connection
  char addr[BT_ADDR_LE_STR_LEN];
  bt_addr_le_to_str(bt_conn_get_dst(conn), addr, sizeof(addr));
  printk("Connected: %s\n", addr);

  discover_params.uuid = &BLE_CUSTOM_SERVICE_UUID.uuid;
  discover_params.func = discover_func;
  discover_params.start_handle = BT_ATT_FIRST_ATTRIBUTE_HANDLE;
  discover_params.end_handle = BT_ATT_LAST_ATTRIBUTE_HANDLE;
  discover_params.type = BT_GATT_DISCOVER_PRIMARY;

  err = bt_gatt_discover(my_connection, &discover_params);
  if (err) {
    printk("Discover failed(err %d)\n", err);
    return;
  }
}

static void ble_on_device_disconnected(struct bt_conn* conn, uint8_t reason) {
  //check if connections match
  if(my_connection != conn){
    return;
  }
  //unref and clear connection
  bt_conn_unref(my_connection);
  my_connection = NULL;
  //reason for disconnect
  char* res = bt_hci_err_to_str(reason);
  printk("Disconnected: %s\n", res);

}

//tells OS when devices are connected or disconnected
BT_CONN_CB_DEFINE(conn_callbacks) = {
  .connected = ble_on_device_connected,
  .disconnected = ble_on_device_disconnected,
};


//checks advertising devices name
static bool ble_get_adv_device_name_cb(struct bt_data* data, void* user_data) {
  char* name = user_data;

  if (data->type == BT_DATA_NAME_COMPLETE || data->type == BT_DATA_NAME_SHORTENED) {
    memcpy(name, data->data, data->data_len);
    name[data->data_len] = 0; // Null-terminator
    return false; // Stop parsing
  }

  return true; // Continue looking through this advertising packet
}
static void ble_on_advertisement_received(const bt_addr_le_t* addr, int8_t rssi, uint8_t type,
                                          struct net_buf_simple* ad) {
  //check if connection exists
  if(my_connection != NULL){
    return;
  }

  if(type != BT_GAP_ADV_TYPE_ADV_IND && type != BT_GAP_ADV_TYPE_ADV_DIRECT_IND){
    return;
  }
  
  //parse name
  char name[32] = {0};
  bt_data_parse(ad, ble_get_adv_device_name_cb, name);
  printk("NAME: %s\n", name); 

  //convert MAC address to str and store in addr_str
  char addr_str[BT_ADDR_LE_STR_LEN];
  bt_addr_le_to_str(addr, addr_str, sizeof(addr_str));
  printk("ADDR: %s\n", addr_str);
  printk("RSSI: %d\n", rssi );
  

  if(strcmp("Jad", name)){
    printk("Wrong Name\n");
    return;
  }
  //no weak signals
  if(rssi < -50){
    return;
  }

  //stop scanning
  int err = bt_le_scan_stop();
  if(err){
    printk("Failed to stop scan (err %d)\n", err);
    return;
  }

  //create connection with device
  err = bt_conn_le_create(addr, BT_CONN_LE_CREATE_CONN, BT_LE_CONN_PARAM_DEFAULT, &my_connection);
  if(err){
    printk("Connection create failed (err %d)\n", err);
    return;
  }


}

int main(void) {
  //init led and buttons
  if (0 > BTN_init()) {
    return 0;
  }
  if (0 > LED_init()) {
    return 0;
  }

  //enable blue tooth
  int err = bt_enable(NULL);
  if (err) {
    printk("Bluetooth init failed (err %d)\n", err);
    return 0;
  } else {
    printk("Bluetooth initialized\n");
  }

  bt_le_scan_start(BT_LE_SCAN_PASSIVE, ble_on_advertisement_received);

  while(1) {
    k_msleep(SLEEP_MS);
  }
	return 0;
}
```

## src/miniprog_fsm.c
```c
/**
 * @file miniproj_fsm.c
 */

#include "miniproj_fsm.h"
//initialze and run
void state_machine_init(){
    state_obj.prev_state = NONE;
    state_obj.ascii_code = 0;
    state_obj.bit_index = 0;
    state_obj.str = NULL;
    state_obj.time_held = 0;

    smf_set_initial(SMF_CTX(&state_obj), &miniproj_states[STATE0]);
}

void state_machine_run(){
    return smf_run_state(SMF_CTX(&state_obj));
}

//helper functions
char* add_char(char* src, uint8_t new_char){
    uint8_t str_size = 0;
    while(src[str_size] != '\0'){
        str_size++;
    }

    char* dest = malloc(sizeof(char) * (str_size + 2));
    if (!dest) return NULL;

    uint8_t i = 0;
    while(src[i] != '\0'){
        dest[i] = src[i];
        i++;
    }

    dest[str_size] = (char)new_char;
    dest[str_size + 1] = '\0';
    free(src);
    return dest
}


// state entry, run and exit functions
static void state0_entry(void *o){
    
    LED_blink(LED3, LED_1HZ)
    state_obj.ascii_code = 0;
    state_obj.bit_index = 0;
    state_obj.str = NULL;
}

static enum smf_state_result state0_run(void *o){

    if(BTN_is_pressed(BTN0)){
        state_obj.ascii_code = state_obj.ascii_code << 1;
        state_obj.bit_index++;
        LED_set(LED0, LED_ON);
        k_msleep(100);
        LED_set(LED0, LED_OFF);
    }

    if(BTN_is_pressed(BTN0)){
        state_obj.ascii_code = state_obj.ascii_code << 1 | 1;
        state_obj.bit_index++;
        LED_set(LED1, LED_ON);
        k_msleep(100);
        LED_set(LED1, LED_OFF);
    }

    if (BTN2_pressed()) {
        obj->ascii_code = 0;
        obj->bit_index = 0;
    }

    if(BTN_is_pressed(BTN3) && state_obj.bit_index >= 8){
        state_obj.str = malloc(2* sizeof(char));
        state_obj.str[0] = (char)state_obj.ascii_code;
        state_obj.str[1] = '\0';
        smf_set_state(SMF_CTX(&state_obj), &miniproj_state[STATE1]);
        state_obj.prev_state = STATE0;

    }

    // assuming delay is not exactly 1ms
    if(BTN_is_pressed(BTN0) && BTN_is_pressed(BTN1)){
        if(state_obj.time_held >= 2500){
            state_obj.prev_state = STATE0;
            smf_set_state(SMF_CTX(state_obj), &miniproj_states(STATE3));
        }

        state_obj.time_held++;
    }
    else{
        state_obj.time_held = 0; 
    }

}

static void state1_entry(void *o){
    LED_blink(LED3, LED_4HZ);
}

static enum smf_state_result state1_run(void *o){

    if(BTN_is_pressed(BTN0)){
        state_obj.ascii_code = state_obj.ascii_code << 1;
        state_obj.bit_index++;
        LED_set(LED0, LED_ON);
        k_msleep(100);
        LED_set(LED0, LED_OFF);
    }

    if(BTN_is_pressed(BTN0)){
        state_obj.ascii_code = state_obj.ascii_code << 1 | 1;
        state_obj.bit_index++;
        LED_set(LED1, LED_ON);
        k_msleep(100);
        LED_set(LED1, LED_OFF);
    }

    if (BTN2_pressed()) {
        state_obj.ascii_code = 0;
        state_obj.bit_index = 0;
        free(state_obj.str);
        smf_set_state(SMF_CTX(&state_obj), &miniproj_state[STATE0]);
    }

    if(state_obj.bit_index >= 8){
        state_obj.str = malloc(2* sizeof(char));
        state_obj.str[0] = (char)state_obj.ascii_code;
        state_obj.str[1] = '\0';
        smf_set_state(SMF_CTX(&state_obj), &miniproj_state[STATE1]);
        state_obj.prev_state = STATE0;

    }

    // assuming delay is not exactly 1ms
    if(BTN_is_pressed(BTN0) && BTN_is_pressed(BTN1)){
        if(state_obj.time_held >= 2500){
            state_obj.prev_state = STATE0;
            smf_set_state(SMF_CTX(state_obj), &miniproj_states(STATE3));
        }

        state_obj.time_held++;
    }
    else{
        state_obj.time_held = 0; 
    }

}
```

## src/miniproj_fsm.c
```c
/**
 * @file miniproj_fsm.c
 */

#include "miniproj_fsm.h"

//initialze and run
void state_machine_init(){
    state_obj.prev_state = NONE;
    state_obj.ascii_code = 0;
    state_obj.bit_index = 0;
    state_obj.str = NULL;
    state_obj.time_held = 0;
    state_obj.string_size = 0;

    smf_set_initial(SMF_CTX(&state_obj), &miniproj_states[STATE0]);
}

int state_machine_run(){
    return smf_run_state(SMF_CTX(&state_obj));
}

//helper functions
char* add_char(char* src, uint8_t new_char){
    uint8_t str_size = 0;
    while(src[str_size] != '\0'){
        str_size++;
    }

    char* dest = malloc(sizeof(char) * (str_size + 2));
    if (!dest) return NULL;

    uint8_t i = 0;
    while(src[i] != '\0'){
        dest[i] = src[i];
        i++;
    }

    dest[str_size] = (char)new_char;
    dest[str_size + 1] = '\0';
    free(src);
    return dest;
}

void pwm_fade(){
    if(state_obj.brighter){
        if(state_obj.duty_cycle >= 100){
            LED_pwm(LED0, state_obj.duty_cycle);
            LED_pwm(LED1, state_obj.duty_cycle);
            LED_pwm(LED2, state_obj.duty_cycle);
            LED_pwm(LED3, state_obj.duty_cycle);
            k_msleep(10);
            state_obj.brighter = false;
        }
        else{
            LED_pwm(LED0, state_obj.duty_cycle);
            LED_pwm(LED1, state_obj.duty_cycle);
            LED_pwm(LED2, state_obj.duty_cycle);
            LED_pwm(LED3, state_obj.duty_cycle);
            state_obj.duty_cycle++;
            k_msleep(10);
        }
    }
    if(!state_obj.brighter){
        if(state_obj.duty_cycle <= 0){
            LED_pwm(LED0, state_obj.duty_cycle);
            LED_pwm(LED1, state_obj.duty_cycle);
            LED_pwm(LED2, state_obj.duty_cycle);
            LED_pwm(LED3, state_obj.duty_cycle);
            state_obj.brighter = true;
            k_msleep(10);
        }
        else{
            LED_pwm(LED0, state_obj.duty_cycle);
            LED_pwm(LED1, state_obj.duty_cycle);
            LED_pwm(LED2, state_obj.duty_cycle);
            LED_pwm(LED3, state_obj.duty_cycle);
            state_obj.duty_cycle--;
            k_msleep(10);
        }
    }
}


// state entry, run and exit functions
static void state0_entry(void *o){
    
    LED_blink(LED3, LED_1HZ);
    state_obj.ascii_code = 0;
    state_obj.bit_index = 0;
    state_obj.str = NULL;
    state_obj.time_held = 0; 
}

static enum smf_state_result state0_run(void *o){

    if(BTN_is_pressed(BTN0)){
        state_obj.ascii_code = state_obj.ascii_code << 1;
        state_obj.bit_index++;
        LED_set(LED0, LED_ON);
        k_msleep(300);
        LED_set(LED0, LED_OFF);
        printk("%d", 0);
    }

    if(BTN_is_pressed(BTN1)){
        state_obj.ascii_code = state_obj.ascii_code << 1 | 1;
        state_obj.bit_index++;
        LED_set(LED1, LED_ON);
        k_msleep(300);
        LED_set(LED1, LED_OFF);
        printk("%d", 1);
    }

    if (BTN_is_pressed(BTN2)) {
        state_obj.ascii_code = 0;
        state_obj.bit_index = 0;
        state_obj.string_size = 0;
    }

    if(BTN_is_pressed(BTN3) && state_obj.bit_index >= 8){
        if (state_obj.str) free(state_obj.str);
        state_obj.str = malloc(2* sizeof(char));
        state_obj.str[0] = (char)state_obj.ascii_code;
        state_obj.str[1] = '\0';
        printk(" : %c", state_obj.ascii_code);
        printk("\n");
        printk("----SAVED----\n\n");
        smf_set_state(SMF_CTX(&state_obj), &miniproj_states[STATE1]);
        state_obj.prev_state = STATE0;
        state_obj.string_size++;
        state_obj.bit_index = 0;
        state_obj.ascii_code = 0;

    }

   
    if (BTN_is_pressed(BTN0) && BTN_is_pressed(BTN1)) {
        uint32_t start = (uint32_t)state_obj.time_held;
        uint32_t now = k_uptime_get_32();
        if (start == 0U) {
            state_obj.time_held = now; /* start timer */
        } else if ((uint32_t)(now - start) >= 2500U) {
            state_obj.prev_state = STATE0;
          
            smf_set_state(SMF_CTX(&state_obj), &miniproj_states[STATE3]);
            state_obj.time_held = 0; /* reset to avoid repeated transitions */
            printk("----STANDBY----\n");
        }
    } else {
        state_obj.time_held = 0;
    }
    return SMF_EVENT_HANDLED;

}

static void state1_entry(void *o){
    LED_blink(LED3, LED_4HZ);
    state_obj.time_held = 0;
    k_msleep(1000);
}

static enum smf_state_result state1_run(void *o){

    if(BTN_is_pressed(BTN0)){
        state_obj.ascii_code = state_obj.ascii_code << 1;
        state_obj.bit_index++;
        LED_set(LED0, LED_ON);
        k_msleep(300);
        LED_set(LED0, LED_OFF);
        printk("%d", 0);
    }

    if(BTN_is_pressed(BTN1)){
        state_obj.ascii_code = state_obj.ascii_code << 1 | 1;
        state_obj.bit_index++;
        LED_set(LED1, LED_ON);
        k_msleep(300);
        LED_set(LED1, LED_OFF);
        printk("%d", 1);
    }

    if (BTN_is_pressed(BTN2)) {
        state_obj.ascii_code = 0;
        state_obj.bit_index = 0;
        state_obj.string_size = 0;
        free(state_obj.str);
        smf_set_state(SMF_CTX(&state_obj), &miniproj_states[STATE0]);
    }

    if(state_obj.bit_index == 8){
        state_obj.str = add_char(state_obj.str, state_obj.ascii_code);
        printk(" : %c", state_obj.ascii_code);
        printk("\n");
        state_obj.bit_index = 0;
        state_obj.ascii_code = 0;
        state_obj.string_size++;

    }

    if(BTN_is_pressed(BTN3)){
        state_obj.prev_state = STATE1;
        printk("----SAVED_STRING----\n");
        smf_set_state(SMF_CTX(&state_obj), &miniproj_states[STATE2]);
    }


    if (BTN_is_pressed(BTN0) && BTN_is_pressed(BTN1)) {
        uint32_t start = (uint32_t)state_obj.time_held;
        uint32_t now = k_uptime_get_32();
        if (start == 0U) {
            state_obj.time_held = now; /* start timer */
        } else if ((uint32_t)(now - start) >= 2500U) {
            state_obj.prev_state = STATE1;
            smf_set_state(SMF_CTX(&state_obj), &miniproj_states[STATE3]);
            printk("----STANDBY----\n");
            state_obj.time_held = 0; /* reset to avoid repeated transitions */
        }
    } else {
        state_obj.time_held = 0;
    }

    return SMF_EVENT_HANDLED;
}

static void state2_entry(void *o){
    LED_blink(LED3, LED_16HZ);
    state_obj.time_held = 0; 
}

static enum smf_state_result state2_run(void *o){
    if(BTN_is_pressed(BTN3)){
        printk("%s\n", state_obj.str);
        k_msleep(500);
    }

    if(BTN_is_pressed(BTN2)){
        free(state_obj.str);
        state_obj.prev_state = STATE2;
        smf_set_state(SMF_CTX(&state_obj), &miniproj_states[STATE0]);
        printk("----CHAR ENTRY----\n");
    }

    // assuming delay is not exactly 1ms
   if (BTN_is_pressed(BTN0) && BTN_is_pressed(BTN1)) {
        uint32_t start = (uint32_t)state_obj.time_held;
        uint32_t now = k_uptime_get_32();
        if (start == 0U) {
            state_obj.time_held = now; /* start timer */
        } else if ((uint32_t)(now - start) >= 2500U) {
            state_obj.prev_state = STATE2;
            smf_set_state(SMF_CTX(&state_obj), &miniproj_states[STATE3]);
            state_obj.time_held = 0; /* reset to avoid repeated transitions */
            printk("----STANDBY----\n");
        }
    } else {
        state_obj.time_held = 0;
    }

    return SMF_EVENT_HANDLED;
}

static void state3_entry(void *o){
    state_obj.brighter = true;
    state_obj.duty_cycle = 0;
    LED_set(LED0, LED_OFF);
    LED_set(LED1, LED_OFF);
    LED_set(LED2, LED_OFF);
    LED_set(LED3, LED_OFF);
    k_msleep(1000);
}

static enum smf_state_result state3_run(void *o){
    if(BTN_is_pressed(BTN0) || BTN_is_pressed(BTN1)|| BTN_is_pressed(BTN2)|| BTN_is_pressed(BTN3)){
        LED_set(LED0, LED_OFF);
        LED_set(LED1, LED_OFF);
        LED_set(LED2, LED_OFF);
        LED_set(LED3, LED_OFF); 
        printk("%d", state_obj.prev_state);
        smf_set_state(SMF_CTX(&state_obj), &miniproj_states[state_obj.prev_state]);
    }
    else{
        pwm_fade();
    }

    return SMF_EVENT_HANDLED;
}
```

## src/miniproj_fsm.h
```c
/**
 * @file miniproj_fsm.h
 */
//includes
#include <stdlib.h>
#include <zephyr/smf.h>
#include "LED.h"
#include "BTN.h"

//defines and macros
 #ifndef MINIPROJ_FSM_H
 #define MINIPROJ_FSM_H
 
 #define MAX_STR_SIZE = 16;

 //function prototypes
 void state_machine_init();
 int state_machine_run();

 char* add_char(char *src, uint8_t new_char);
 void pwm_fade();

 static void state0_entry(void *o);
 static enum smf_state_result state0_run(void *o);

 static void state1_entry(void *o);
 static enum smf_state_result state1_run(void *o);

 static void state2_entry(void *o);
 static enum smf_state_result state2_run(void *o);

 static void state3_entry(void *o);
 static enum smf_state_result state3_run(void *o);

 //typedefs
 enum miniproj_states{
    NONE,
    STATE0,
    STATE1,
    STATE2,
    STATE3,
 };

 typedef struct {
    struct smf_ctx ctx;

    enum miniproj_states prev_state;
    uint8_t ascii_code;
    uint8_t bit_index;
    char* str;
    uint64_t time_held;
    uint8_t string_size;
    uint8_t duty_cycle;
    bool brighter;
 } miniproj_states_object_t;

 //local variables

 static const struct smf_state miniproj_states[] = {
    [STATE0] = SMF_CREATE_STATE(state0_entry, state0_run, NULL, NULL, NULL),
    [STATE1] = SMF_CREATE_STATE(state1_entry, state1_run, NULL, NULL, NULL),
    [STATE2] = SMF_CREATE_STATE(state2_entry, state2_run, NULL, NULL, NULL),
    [STATE3] = SMF_CREATE_STATE(state3_entry, state3_run, NULL, NULL, NULL)
 };

 static miniproj_states_object_t state_obj;

 #endif
```

## src/my_state_machine.c
```c
/**
 * @file my_state_machine.c
 */

 #include <zephyr/smf.h>

 #include "LED.h"
 #include "BTN.h"
 #include "my_state_machine.h"

 static void s0_state_entry(void* o);
 static enum smf_state_result state_0(void* o);

 static void s1_state_entry(void* o);
 static enum smf_state_result state_1(void* o);

 static void s2_state_entry(void* o);
 static enum smf_state_result state_2(void* o);

 static void s3_state_entry(void* o);
 static enum smf_state_result state_3(void* o);

 static void s4_state_entry(void* o);
 static enum smf_state_result state_4(void* o);


 enum led_state_machine_states{
    S0,
    S1,
    S2,
    S3,
    S4
 };

 typedef struct{
    struct smf_ctx ctx;
    uint16_t count;
    enum btn_id_t btn;
 }led_state_object_t;

 static const struct smf_state led_states[] = {
    [S0] = SMF_CREATE_STATE(s0_state_entry, state_0, NULL, NULL, NULL),
    [S1] = SMF_CREATE_STATE(s1_state_entry, state_1, NULL, NULL, NULL),
    [S2] = SMF_CREATE_STATE(s2_state_entry, state_2, NULL, NULL, NULL),
    [S3] = SMF_CREATE_STATE(s3_state_entry, state_3, NULL, NULL, NULL),
    [S4] = SMF_CREATE_STATE(s4_state_entry, state_4, NULL, NULL, NULL)
 };

 static led_state_object_t led_state_object;

 void button_pressed(){
   if(BTN_is_pressed(BTN0)){
      led_state_object.btn = BTN0;
   }
   else if(BTN_is_pressed(BTN1)){
      led_state_object.btn = BTN1;
   }
   else if(BTN_is_pressed(BTN2)){
      led_state_object.btn = BTN2;
   }
   else if(BTN_is_pressed(BTN3)){
      led_state_object.btn = BTN3;
   }
 }

 void state_machine_init(){
   printk("state 0");
    led_state_object.count = 0;
    smf_set_initial(SMF_CTX(&led_state_object), &led_states[S0]);
 }

 int state_machine_run(){
    return smf_run_state(SMF_CTX(&led_state_object));
 }


// State 0 entry function and running function
 static void s0_state_entry(void* o){
   LED_set(LED0, LED_OFF);
   LED_set(LED1, LED_OFF);
   LED_set(LED2, LED_OFF);
   LED_set(LED3, LED_OFF);
 }
 
 static enum smf_state_result state_0(void* o){
      if(led_state_object.btn == BTN0){
         printk("state 1");
         led_state_object.count = 0;
         smf_set_state(SMF_CTX(&led_state_object), &led_states[S1]);
      }
      else{
         button_pressed();
         led_state_object.count++;
      }
      return SMF_EVENT_HANDLED;
 }

// State 1 entry function and running function
static void s1_state_entry(void *o){
   LED_blink(LED0, LED_4HZ);
}

 static enum smf_state_result state_1(void* o){
   if(led_state_object.btn == BTN2){
      printk("state 4");
      led_state_object.count = 0;
      smf_set_state(SMF_CTX(&led_state_object), &led_states[S4]); 
   }
   else if(led_state_object.btn == BTN1){
      printk("state 2");
      led_state_object.count = 0;
      smf_set_state(SMF_CTX(&led_state_object), &led_states[S2]); 
   }
   else if(led_state_object.btn == BTN3){
      printk("state 0");
      led_state_object.count = 0;
      smf_set_state(SMF_CTX(&led_state_object), &led_states[S0]); 
   }
   else{
      button_pressed();
      led_state_object.count++;
   }
   return SMF_EVENT_HANDLED;
 }

 // State 2 entry function and running function
 static enum smf_state_result state_2(void* o){
   if(led_state_object.count > 1000){
      printk("state 3");
      led_state_object.count = 0;
      smf_set_state(SMF_CTX(&led_state_object), &led_states[S3]);
   }
   else if(led_state_object.btn == BTN3){
      printk("state 0");
      led_state_object.count = 0;
      smf_set_state(SMF_CTX(&led_state_object), &led_states[S0]);
   }
   else{
      button_pressed();
      led_state_object.count++;
   }
   return SMF_EVENT_HANDLED;
}
 
 static void s2_state_entry(void *o){
   LED_set(LED0, LED_ON);
   LED_set(LED2, LED_ON);
   LED_set(LED3, LED_OFF);
   LED_set(LED1, LED_OFF);
}

// State 3 entry function and running function
static enum smf_state_result state_3(void* o){
   if(led_state_object.count > 2000){
      printk("state 2");
      led_state_object.count = 0;
      smf_set_state(SMF_CTX(&led_state_object), &led_states[S2]);
   }
   else if(led_state_object.btn == BTN3){
      printk("state 0");
      led_state_object.count = 0;
      smf_set_state(SMF_CTX(&led_state_object), &led_states[S0]);
   }
   else{
      button_pressed();
      led_state_object.count++;
   }
   return SMF_EVENT_HANDLED;

}

 static void s3_state_entry(void *o){
   LED_set(LED0, LED_OFF);
   LED_set(LED2, LED_OFF);
   LED_set(LED3, LED_ON);
   LED_set(LED1, LED_ON);
}

// State 4 entry function and running function

static enum smf_state_result state_4(void *o){
   if(led_state_object.btn == BTN3){
      printk("state 2");
      led_state_object.count = 0;
      smf_set_state(SMF_CTX(&led_state_object), &led_states[S2]); 
   }
   else{
      button_pressed();
      led_state_object.count++;
   }
   return SMF_EVENT_HANDLED;
}

static void s4_state_entry(void* o){
   LED_blink(LED0, LED_16HZ);
   LED_blink(LED1, LED_16HZ);
   LED_blink(LED2, LED_16HZ);
   LED_blink(LED3, LED_16HZ);
}
```

## src/my_state_machine.h
```c
/** 
* @file my_state_machine.h
*/

#ifndef MY_STATE_MACHINE_H
#define MY_STATE_MACHINE_H

void state_machine_init();

int state_machine_run();

#endif // MY_STATE_MACHINE_H
```
